#include <input/processors.dtsi>
#include <dt-bindings/zmk/input_transform.h> /* ←これを追加します */

&pointing_listener {
    status = "okay";
    device = <&pointing_device>;
    
    input-processors = 
        <&zip_temp_layer 4 1000>,
        <&zip_xy_scaler 7 4>,
        <&zip_xy_transform (INPUT_TRANSFORM_X_INVERT | INPUT_TRANSFORM_Y_INVERT)>; /* ←これを追加します */
        /* ---- ここから下を追記：スクロールモードの設定 ---- */
    scroll {
        layers = <2>; /* レイヤー2がオンの時だけ発動します */
        
        input-processors = 
            <&zip_xy_to_scroll_mapper>, /* ボールの動きをスクロールに変換 */
            
            /* 【注意】スクロールの方向も反転させる必要がある場合は、以下の行も必要です */
            <&zip_scroll_transform (INPUT_TRANSFORM_X_INVERT | INPUT_TRANSFORM_Y_INVERT)>;
    };
    snipe {
        layers = <3>; /* レイヤー3がオンの時だけ発動 */
        input-processors = <&zip_xy_scaler 1 3>, /* 速度を3分の1にする */

        /* ↓ ここにも通常時と同じ反転設定を追加します ↓ */
            <&zip_xy_transform (INPUT_TRANSFORM_X_INVERT | INPUT_TRANSFORM_Y_INVERT)>;
    };
};